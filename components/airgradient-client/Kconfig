## components/airgradient-client/Kconfig
```kconfig
menu "AirGradient Client"

    choice AG_CLIENT_MEASURES_TYPE
        prompt "Client measures type"
        default AG_CLIENT_MEASURES_TYPE_FULL
        help
            Selects which Measures variant the client serializes and posts.
            Must match the variant produced by the application; no
            conversion is performed.

        config AG_CLIENT_MEASURES_TYPE_FULL
            bool "Measures"

        config AG_CLIENT_MEASURES_TYPE_BASIC
            bool "MeasuresBasic"

        config AG_CLIENT_MEASURES_TYPE_AGO
            bool "MeasuresAGo"
    endchoice

    config AG_CLIENT_CELLULAR_SUPPORT
        bool "Enable cellular modem support"
        default n
        help
            When enabled, AgClient can use a CellularModem for CoAP and
            MQTT operations, and the CellularHttpClient backend is built
            for OTA use. Adds a build dependency on airgradient-cellular.
            Note: cellular backends are not implemented in the current
            release; enabling this flag has no effect yet.

endmenu
```

## components/airgradient-common/Kconfig
```kconfig
menu "AirGradient Common"

    choice AG_DEVICE_MODEL
        prompt "Device model"
        default AG_DEVICE_MODEL_ONE_OPEN_AIR
        help
            Selects the AirGradient device model for model-specific component
            behavior and server endpoints.

        config AG_DEVICE_MODEL_ONE_OPEN_AIR
            bool "One / Open Air"

        config AG_DEVICE_MODEL_MAX
            bool "Max"

        config AG_DEVICE_MODEL_GO
            bool "Go"
    endchoice

endmenu
```

## components/airgradient-local-server/Kconfig
```kconfig
menu "AirGradient Local Server"

    config AG_LOCAL_SERVER_JSON_BUF
        int "Static scratch buffer for serialized GET payloads (bytes)"
        range 1024 16384
        default 3072
        help
            Size of the per-LocalServer static scratch buffer used to
            serialize GET /api/v1/measures and GET /api/v1/config payloads
            with cJSON_PrintPreallocated. The body is borrowed (zero-copy)
            by HttpResponse::body_static, so it must be large enough to hold
            the largest supported payload for the product.

endmenu
```

## components/airgradient-ota/Kconfig
```kconfig
menu "AirGradient OTA"

    config AG_OTA_HTTP_TIMEOUT_MS
        int "HTTP connect/read timeout (ms)"
        range 1000 120000
        default 15000
        help
            Connect and per-read timeout for the WiFi OTA download. Passed to
            esp_http_client as timeout_ms.

    config AG_OTA_READ_BUFFER_SIZE
        int "Per-read download/flash buffer (bytes)"
        range 256 16384
        default 1024
        help
            Size of the stack buffer OtaUpdater uses for each read()/write()
            iteration. Larger buffers reduce the number of esp_ota_write calls
            at the cost of more stack on the run() task.

    config AG_OTA_PROGRESS_INTERVAL_MS
        int "Minimum gap between progress callbacks (ms)"
        range 0 10000
        default 1000
        help
            Throttle interval for OtaProgressCallback during the download loop.
            The terminal and milestone states are always emitted regardless of
            this interval.

    config AG_OTA_URL_BUFFER_SIZE
        int "Max built firmware URL length (bytes)"
        range 64 1024
        default 256
        help
            Size of the internal buffer that holds the firmware URL built from
            the OtaRequest. Builds that would overflow this buffer fail with
            InvalidArgument.

    config AG_OTA_BLE_DATA_MAX_BYTES
        int "BLE max accepted single Data write (bytes)"
        range 128 2048
        default 512
        help
            Maximum accepted size of a single Data write on the BLE push OTA
            path (approximately the max ATT payload). Larger Data writes are
            rejected. Flashed straight from the write callback; there is no
            chunk buffer. Confirm against the negotiated ATT MTU on target.

    config AG_OTA_BLE_CONTROL_MAX_BYTES
        int "BLE max accepted Control write size (bytes)"
        range 16 256
        default 64
        help
            Maximum accepted Control (START/END/ABORT) CBOR write size on the
            BLE push path. Larger writes are rejected with InvalidArgument.

    config AG_OTA_BLE_FW_MAX_LEN
        int "BLE max 'fw' version string length (bytes)"
        range 8 128
        default 32
        help
            Maximum length of the informational 'fw' string copied from a BLE
            START payload. Longer values are treated as a reject.

    config AG_OTA_BLE_STALL_TIMEOUT_MS
        int "BLE silent-phone stall timeout (ms)"
        range 1000 120000
        default 10000
        help
            Silent-phone byte-progress watchdog window for the BLE push path.
            run() aborts the transfer if no Data bytes are accepted within this
            span. Detection granularity is CONFIG_AG_OTA_BLE_PROGRESS_INTERVAL_MS.

    config AG_OTA_BLE_PROGRESS_INTERVAL_MS
        int "BLE progress log/NOTIFY / run() tick interval (ms)"
        range 100 60000
        default 5000
        help
            How often run() wakes while streaming to emit a progress INFO log
            and a progress Status NOTIFY (carrying the device's real byte
            count), and the granularity of the silent-phone stall watchdog.
            Keep this well below CONFIG_AG_OTA_BLE_STALL_TIMEOUT_MS.

endmenu
```

## components/airgradient-payload-cache/Kconfig
```kconfig
menu "AirGradient Payload Cache"

    config PAYLOAD_CACHE_MAX_SIZE
        int "Maximum payload cache slots"
        range 2 1024
        default 16
        help
            Configures the number of payload buffer slots allocated for the
            payload cache. With the current head/tail ring-buffer design, the
            usable queue capacity is one less than this value.

    choice PAYLOAD_CACHE_TYPE
        prompt "Payload cache payload type"
        default PAYLOAD_CACHE_TYPE_FULL
        help
            Selects which shared payload structure is stored in the payload
            cache.

        config PAYLOAD_CACHE_TYPE_FULL
            bool "Measures"

        config PAYLOAD_CACHE_TYPE_BASIC
            bool "MeasuresBasic"

        config PAYLOAD_CACHE_TYPE_AGO
            bool "MeasuresAGo"
    endchoice

endmenu
```

## components/airgradient-provisioning/Kconfig
```kconfig
menu "AirGradient Provisioning"

    config AG_PROVISIONING_DEFAULT_OVERALL_TIMEOUT_MS
        int "Default inactivity timeout (ms)"
        range 0 3600000
        default 0
        help
            Default value used when a product does not explicitly set
            ProvisioningConfig::overall_timeout_ms. 0 disables the
            inactivity timeout entirely.

endmenu
```

## components/airgradient-sensors/Kconfig
```kconfig
menu "AirGradient Sensors"

    config AVERAGING_ITERATION_INTERVAL_MS
        int "Averaging iteration interval (ms)"
        range 100 10000
        default 2000
        help
            Target wall-clock duration of one averaging iteration inside
            SensorManager::start_measures(). Each iteration polls all active
            sensors and then delays until this many milliseconds have elapsed
            since the iteration started. Lower values increase sampling rate
            at the cost of more CPU / I2C traffic and power.

    config SENSOR_WARMUP_DURATION_MS
        int "Sensor warmup total duration (ms)"
        range 0 60000
        default 10000
        help
            Total default duration of SensorManager::warmup_sensor(). The
            default iteration count passed to warmup_sensor() is derived as
            SENSOR_WARMUP_DURATION_MS / SENSOR_WARMUP_INTERVAL_MS. Used to
            condition TVOC/NOx sensors (e.g. SGP41) and spin up PM sensor
            fans/lasers before the first real measurement.

    config SENSOR_WARMUP_INTERVAL_MS
        int "Sensor warmup iteration interval (ms)"
        range 100 10000
        default 1000
        help
            Duration of a single warmup iteration inside
            SensorManager::warmup_sensor(). Each iteration runs one TVOC/NOx
            conditioning cycle and one PM read, then delays until this many
            milliseconds have elapsed since the iteration started.

endmenu
```

## products/go/main/Kconfig.projbuild
```kconfig
menu "AirGradient Go"

    config GO_PORTABLE_PROV_RADIO_IDLE_MS
        int "Portable provisioning Wi-Fi radio idle timeout (ms)"
        range 10000 600000
        default 90000
        help
            In Portable mode, attached Wi-Fi provisioning brings the Wi-Fi
            radio up on demand for a scan / connect and drops it again to
            preserve the Portable power profile. This bounds how long the
            radio stays powered after the last scan/credentials request even
            while the app remains connected on the BLE link. The timer is
            armed/re-armed on every request and cancelled when the radio
            drops (on connect verify-then-drop, BLE disconnect, or mode exit).

    config TRACKING_FSYNC_INTERVAL_MS
        int "Tracking fsync interval (ms)"
        range 1000 600000
        default 30000
        help
            Maximum age of unsynced route points before append_route_point()
            forces an fflush + fsync. Bounds worst-case data loss on a
            power cut. Lower = safer; higher = less NAND wear.

endmenu
```
